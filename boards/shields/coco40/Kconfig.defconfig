## boards/shields/coco40/Kconfig.defconfig
```kconfig
if SHIELD_COCO40_LEFT

config ZMK_KEYBOARD_NAME
    default "coco40"

endif

if SHIELD_COCO40_LEFT || SHIELD_COCO40_RIGHT

config ZMK_SPLIT
    default y

endif
```

## boards/shields/coco40/Kconfig.shield
```kconfig
config SHIELD_COCO40_LEFT
    def_bool $(shields_list_contains,coco40_left)
config SHIELD_COCO40_RIGHT
    def_bool $(shields_list_contains,coco40_right)
```
